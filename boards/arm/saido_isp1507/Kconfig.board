## boards/arm/saido_isp1507/Kconfig.board
```kconfig
# Copyright (c) 2022 Nordic Semiconductor ASA
# SPDX-License-Identifier: Apache-2.0

config BOARD_SAIDO_ISP1507
	bool "saido_isp1507"
	depends on SOC_NRF52832_CIAA
```

## boards/arm/saido_isp1507/Kconfig.defconfig
```kconfig
# Copyright (c) 2022 Nordic Semiconductor ASA
# SPDX-License-Identifier: Apache-2.0

if BOARD_SAIDO_ISP1507

config BOARD
	default "saido_isp1507"

config BT_CTLR
   default BT

endif
```

## boards/arm/saido_isp1507/saido_isp1507_defconfig
```kconfig
# Copyright (c) 2022 Nordic Semiconductor ASA
# SPDX-License-Identifier: Apache-2.0

CONFIG_SOC_SERIES_NRF52X=y
CONFIG_SOC_NRF52832_CIAA=y
CONFIG_BOARD_SAIDO_ISP1507=y

# Enable MPU
CONFIG_ARM_MPU=y

# Enable hardware stack protection
CONFIG_HW_STACK_PROTECTION=y

# Enable RTT
CONFIG_USE_SEGGER_RTT=y

# enable GPIO
CONFIG_GPIO=y

# enable console
CONFIG_CONSOLE=y
CONFIG_RTT_CONSOLE=y
```
